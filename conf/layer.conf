## conf/layer.conf
```bitbake
# We have a conf and classes directory, add to BBPATH
BBPATH .= ":${LAYERDIR}"

# We have recipes-* directories, add to BBFILES
BBFILES += "${LAYERDIR}/recipes-*/*/*.bb \
            ${LAYERDIR}/recipes-*/*/*.bbappend"

BBFILE_COLLECTIONS += "meta-pi-cardano"
BBFILE_PATTERN_meta-pi-cardano = "^${LAYERDIR}/"
BBFILE_PRIORITY_meta-pi-cardano = "6"

LAYERDEPENDS_meta-pi-cardano = "core raspberrypi rust-bin-layer"
LAYERSERIES_COMPAT_meta-pi-cardano = "hardknott"

ENABLE_UART ?= "1"
```

## wic/sdimage-pi-cardano-node.wks
```
# short-description: Create Cardano-node Raspberry Pi SD card image
# long-description:  Create Cardano-node Raspberry Pi SD card image

part /boot --source bootimg-partition --ondisk mmcblk0 --fstype=vfat --label boot --active --align 4096 --size 256M --overhead-factor 1
part / --source rootfs --ondisk mmcblk0 --fstype=ext4 --label root --align 4096 --size 20G --overhead-factor 1
part swap --ondisk mmcblk0 --fstype=swap --align 4096 --size 4G --overhead-factor 1
```
